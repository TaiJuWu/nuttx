## arch/arm64/src/rpi4b/Kconfig
```kconfig
#
# For a description of the syntax of this configuration file,
# see the file kconfig-language.txt in the NuttX tools repository.
#

if ARCH_CHIP_RPI4B

menu "Raspberry Chip Selection"

choice
	prompt "Raspberry Core Configuration"
	default ARCH_CHIP_RPI4B_A72

config ARCH_CHIP_RPI4B_A72
	bool "Raspberry Processor (cortex-a72)"
	select ARCH_HAVE_MULTICPU
	select ARMV8A_HAVE_GICv2
	select ARCH_HAVE_PCSI
	select ARCH_CORTEX_A72

endchoice # Raspberry Chip Selection

endmenu # "Raspberry Chip Selection"

endif # ARCH_CHIP_RPI4B
```
